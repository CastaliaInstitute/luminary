## firmware/luminary-background-viewer/main/Kconfig.projbuild
```kconfig
menu "Luminary Network"

    config LUMINARY_WIFI_SSID
        string "Wi-Fi SSID"
        default "$(LUMINARY_BUILD_WIFI_SSID)"
        help
            Network used by the Luminary live-condition client. The build
            injects this value from the local environment into gitignored
            sdkconfig; it is never committed to the repository.

    config LUMINARY_WIFI_PASSWORD
        string "Wi-Fi password"
        default "$(LUMINARY_BUILD_WIFI_PASSWORD)"
        help
            WPA2/WPA3 password injected from the local macOS Keychain into
            gitignored sdkconfig.

    config LUMINARY_WIFI_MAXIMUM_RETRY
        int "Maximum connection retries"
        default 12
        range 1 100

    config LUMINARY_RUNTIME_BASE_URL
        string "Autonomous runtime bundle URL"
        default "https://raw.githubusercontent.com/CastaliaInstitute/luminary/runtime-live/site/runtime/v1"
        help
            HTTPS directory containing manifest.json and its cache-busted
            runtime assets. The P4 pulls this bundle itself after Wi-Fi joins.

    config LUMINARY_RUNTIME_POLL_SECONDS
        int "Runtime bundle poll interval in seconds"
        default 300
        range 60 86400

endmenu

menu "Luminary Renderer"

    config LUMINARY_RENDER_PROFILING
        bool "Report per-phase render timings"
        default n
        help
            Time each phase of the frame -- base copy, wave field, sky, water,
            stars -- and log the breakdown alongside the cadence line. This is
            the instrumentation the render budget was attributed with. It costs
            several esp_timer_get_time() calls per scanline, so leave it off
            for production builds.

endmenu

menu "Luminary Ocean"

    config LUMINARY_OCEAN_SIM
        bool "Drive the sea from the shallow-water solver"
        default n
        help
            Run the fixed-point shallow-water solver on the idle core and
            drive the sea surface from it, instead of from the analytic
            sine-phase field. Shoaling, refraction and breaking then emerge
            from the measured bathymetry rather than being authored.

            Leave this off unless you are working on the solver. The sine
            phase path is the shipping renderer, and the solver still needs
            a screen-to-world mapping before it can register with the
            printed relief.

    config LUMINARY_OCEAN_SIM_HZ
        int "Solver step rate in Hz"
        depends on LUMINARY_OCEAN_SIM
        default 20
        range 1 60
        help
            Measured on the P4 at the 192x192 domain: a step costs 29-33 ms,
            which misses a 33 ms tick, and 20 Hz leaves 40% of the core idle.
            The renderer samples the surface at 6 fps, so anything above
            ~12 Hz looks identical. The scheme stays CFL-stable to 50 ms
            ticks at the full 30 m depth range.

endmenu
```
